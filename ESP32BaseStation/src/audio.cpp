/**
 * @file audio.cpp
 * @brief Plays audio
 *
 * @author Jotham Gates
 * @version 0.1
 * @date 2023-08-18
 */

#include "audio.h"

extern SemaphoreHandle_t serialMutex;
extern QueueHandle_t audioQueue;

// Converted from 'drwho_muted_processed' by TunePlayer Musescore plugin V1.8.2
const uint16_t drwho_muted_processed[] PROGMEM = {
    0xe083, // Tempo change to 131 BPM
    0x461a,0xc000,0x4612,0x463c,0x461a,0xc000,0x4612,0x463c,0x461a,0xc000,
    0x4612,0x463c,0x761c,0xc000,0x7612,0x763c,0x463d,0x461b,0x463c,0x461c,
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    0xc018,0xc000,0xb412,0xb4fc,
    0xf000 // End of tune. Stop playing.
};

FlashTuneLoader flashLoader;  // Where the notes come from
ToneSound piezo(PIN_SPEAKER); // What plays the notes
TunePlayer tune;              // Coordinates everything and does things at the right times.

// Located here for now as the library doesn't like being included from other files.
void audioTask(void *pvParameters)
{
    // begin processing
    LOGD("AUDIO", "Beginning");
    while (true)
    {
        // // Wait for something to play.
        LOGD("AUDIO", "Waiting for a play instruction.");
        int fileIndex = 0;
        AlarmState state;
        xQueueReceive(audioQueue, (void *)&state, portMAX_DELAY);
        // TODO: Stop sound on clear;
        if (state != ALARM_OFF)
        {
            // Start playing
            LOGI("AUDIO", "Playing.");
            flashLoader.setTune(drwho_muted_processed);
            tune.begin(&flashLoader, &piezo);
            tune.play();

            // Play the file
            do
            {
                tune.update();
                yield();
            } while (tune.isPlaying());
            tune.stop(); // Go back to beginning.
        }
    }
}