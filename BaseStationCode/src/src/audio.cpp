/**
 * @file audio.cpp
 * @brief Plays audio
 *
 * @author Jotham Gates
 * @version 0.1
 * @date 2023-08-18
 */
#include "audio.h"
#ifdef PIN_SPEAKER

extern SemaphoreHandle_t serialMutex;
extern QueueHandle_t audioQueue;

// Converted from 'Doctor_Who_Theme_Tuneplayer' by TunePlayer Musescore plugin V1.8.2
const uint16_t Doctor_Who_Theme_Tuneplayer[] PROGMEM = {
    0xe0c8, // Tempo change to 200 BPM
    0x4618,0x4618,0x4618,0x4638,0x4618,0x4618,0x4618,0x4618,0x4638,0x4618,
    0x4618,0x4618,0x4618,0x4638,0x4618,0x7638,0x7638,0x5618,0x2618,0x4618,
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    0xb638,0xb618,0xb618,0xb618,0xb618,0xb638,0xb618,0x4978,
    0xf000 // End of tune. Stop playing.
};

FlashTuneLoader flashLoader;  // Where the notes come from
ToneSound piezo(PIN_SPEAKER); // What plays the notes
TunePlayer tune;              // Coordinates everything and does things at the right times.

// Located here for now as the library doesn't like being included from other files.
void audioTask(void *pvParameters)
{
    // begin processing
    LOGD("AUDIO", "Beginning");
    bool skipWait = false;
    while (true)
    {
        // // Wait for something to play.
        LOGD("AUDIO", "Waiting for a play instruction.");
        AlarmState state;
        if (!skipWait)
        {
            xQueueReceive(audioQueue, (void *)&state, portMAX_DELAY);
        }
        skipWait = false;

        if (state != ALARM_OFF)
        {
            // Start playing
            LOGI("AUDIO", "Playing.");
            flashLoader.setTune(Doctor_Who_Theme_Tuneplayer);
            tune.begin(&flashLoader, &piezo);
            tune.play();

            // Play the file
            do
            {
                tune.update();
                yield();
                if (xQueueReceive(audioQueue, (void *)&state, 0))
                {
                    skipWait = true;
                }
            } while (tune.isPlaying() && !skipWait);
            tune.stop(); // Go back to beginning.
        }
    }
}
#endif